## dts/bindings/behaviors/zmk,behavior-led-pattern.yaml
```yaml
# Copyright (c) 2025-2026 amgskobo
# SPDX-License-Identifier: MIT

description: Select, step or set the state of a single external LED

compatible: "zmk,behavior-led-pattern"

include: one_param.yaml

properties:
  "#binding-cells":
    type: int
    required: true
    const: 1
```

## dts/bindings/behaviors/zmk,behavior-led-speed.yaml
```yaml
# Copyright (c) 2025-2026 amgskobo
# SPDX-License-Identifier: MIT

description: Set the animation speed of the LED driven by zmk,behavior-led-pattern

compatible: "zmk,behavior-led-speed"

include: one_param.yaml

properties:
  "#binding-cells":
    type: int
    required: true
    const: 1
```

## dts/bindings/sensor/zmk,led-battery-adc-offset.yaml
```yaml
description: |
  Battery sensor with LED-load ADC voltage compensation.

  Wraps a zmk,battery-voltage-divider. Each sample reads the divider's
  voltage, adds full-duty-offset-mv scaled by the LED duty at that moment, and
  maps the result to a state of charge the way the divider does: over its
  mv-to-pct-thresholds where it has them (the DYA fork), with ZMK's fixed
  lithium-ion line where it does not (upstream). Select this node as
  zmk,battery.

compatible: "zmk,led-battery-adc-offset"

include: base.yaml

properties:
  source-sensor:
    type: phandle
    required: true
    description: >-
      The uncompensated battery sensor: a zmk,battery-voltage-divider, or any
      sensor serving the same gauge channels
  full-duty-offset-mv:
    type: int
    required: true
    description: Measured ADC voltage sag in millivolts at 100 percent LED duty
```

## tests/bsim/battery-sag/module/Kconfig
```kconfig
# Copyright (c) 2026 amgskobo
# SPDX-License-Identifier: MIT

DT_COMPAT_ZMK_TEST_BATTERY_DIVIDER := zmk,test-battery-divider

config ZMK_TEST_BATTERY_DIVIDER
    bool
    default $(dt_compat_enabled,$(DT_COMPAT_ZMK_TEST_BATTERY_DIVIDER))
    select SENSOR
```

## tests/bsim/battery-sag/module/dts/bindings/sensor/zmk,test-battery-divider.yaml
```yaml
# Copyright (c) 2026 amgskobo
# SPDX-License-Identifier: MIT

description: |
  Test stand-in for ZMK's zmk,battery-voltage-divider on nrf52_bsim, which has
  no SAADC. It models the hardware in front of the divider: a battery at a
  fixed voltage that sags under the LED's current in proportion to its duty,
  the physical resistor divider, and the SAADC's 12-bit conversion at gain 1/6
  and its 0.6 V reference. From the converted pin voltage on it repeats the
  divider driver's arithmetic with the devicetree resistor values, and it
  serves the same sensor channels.

compatible: "zmk,test-battery-divider"

include: base.yaml

properties:
  battery-millivolts:
    type: int
    required: true
    description: The battery's open-circuit voltage
  led-sag-mv:
    type: int
    required: true
    description: How far the battery sags at 100 percent LED duty
  actual-output-ohms:
    type: int
    required: true
    description: The physical divider's lower resistor
  actual-full-ohms:
    type: int
    required: true
    description: The physical divider's total resistance
  output-ohms:
    type: int
    required: true
    description: The lower resistor as the devicetree tells the driver
  full-ohms:
    type: int
    required: true
    description: The total resistance as the devicetree tells the driver
  mv-to-pct-thresholds:
    type: array
    description: >-
      As on the DYA fork's zmk,battery-voltage-divider. Without it the sensor
      maps like upstream's divider, with ZMK's fixed lithium-ion line.
```

## tests/integration/firmware/boards/shields/led_patterns_test/Kconfig.defconfig
```kconfig
# Copyright (c) 2026 amgskobo
# SPDX-License-Identifier: MIT

if SHIELD_LED_PATTERNS_TEST

config ZMK_KEYBOARD_NAME
    default "LED patterns"

endif
```

## tests/integration/firmware/boards/shields/led_patterns_test/Kconfig.shield
```kconfig
# Copyright (c) 2026 amgskobo
# SPDX-License-Identifier: MIT

config SHIELD_LED_PATTERNS_TEST
    def_bool $(shields_list_contains,led_patterns_test)
```
